## boards/shields/flying_fox/Kconfig.defconfig
```kconfig
if SHIELD_FLYING_FOX_LEFT

# Name must be less than 16 characters long!
config ZMK_KEYBOARD_NAME
    default "Flying Fox"

config ZMK_SPLIT_ROLE_CENTRAL
    default y

config ZMK_SPLIT_BLE_CENTRAL_PERIPHERALS
  default 1

config BT_MAX_CONN
  default 6

config BT_MAX_PAIRED
  default 6

endif

if SHIELD_FLYING_FOX_LEFT || SHIELD_FLYING_FOX_RIGHT

config ZMK_SPLIT
    default y

endif

# --- Pinctrl Kconfig for part "left" ---
if BOARD_NICE_NANO_V2 && SHIELD_FLYING_FOX_LEFT

config SPI
    default y

endif
```

## boards/shields/flying_fox/Kconfig.shield
```kconfig
config SHIELD_FLYING_FOX_LEFT
    def_bool $(shields_list_contains,flying_fox_left)

config SHIELD_FLYING_FOX_RIGHT
    def_bool $(shields_list_contains,flying_fox_right)
```
